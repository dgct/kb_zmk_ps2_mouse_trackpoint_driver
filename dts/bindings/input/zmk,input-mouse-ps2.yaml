## dts/bindings/input/zmk,input-mouse-ps2.yaml
```yaml
description: PS2 mouse configuration

compatible: "zmk,input-mouse-ps2"

properties:
  ps2-device:
    type: phandle
    required: true
    description: |
      The ps2 device the mouse should use.

  rst-gpios:
    type: phandle-array
    required: false
    description: GPIO to which the RST pin of the device is connected and on which the Power-On-Reset will be performed.

  sampling-rate:
    type: int
    description: Adjusts the sensitivity setting on trackpoint devices. The allowed values are 10, 20, 40, 60, 80, 100, 200 and the default is 100.
    enum:
      - 10
      - 20
      - 40
      - 60
      - 80
      - 100
      - 200

  scroll-mode:
    type: boolean
    description: Enables scroll wheel on mouse devices supporting the Intellimouse extension.

  disable-clicking:
    type: boolean
    description: Disables clicking. Useful when using a PS2 driver that is prone to erros in transmissions to reduce accidental clicks.

  tp-press-to-select:
    type: boolean
    description: Enables mouse clicking by pressing hard on the trackpoint. Not all trackpoints support this feature.

  tp-press-to-select-threshold:
    type: int
    description: Adjusts how sensitive the press-to-select feature is. The range is 0 - 255 and the default is 8. You can also adjust this setting at runtime without recompiling using the &mms behavior. If this setting is enabled, then the runtime behavior won't be saved into the runtime settings.

  tp-up-thresh:
    type: int
    description: Controls the force release threshold for generating a click on the Z-axis. Lower values make it easier to complete a click without fully releasing pressure. Range 0-255, default 255.

  tp-z-time:
    type: int
    description: Controls how sharp/fast a press must be to register as a click (time window in ~10ms units). Higher values are more forgiving for slow presses. Range 0-255, default 38.

  tp-jenks-curv:
    type: int
    description: Minimum curvature of the force profile for a double-click to register. Lower values make double-click easier. Range 0-255, default 135.

  tp-drag-hysteresis:
    type: int
    description: How hard it is to start a drag while Z-axis is pressed. 255 effectively disables drag. Lower values enable click-and-drag via the trackpoint cap. Range 0-255, default 255.

  tp-min-drag:
    type: int
    description: Minimum sustained force needed to keep a drag active. Only relevant if drag-hysteresis is lowered. Range 0-255, default 20.

  tp-reach:
    type: int
    description: Backup range for Z-axis press detection. Controls the proximity zone before the force threshold engages. Range 0-255, default 10.

  tp-sensitivity:
    type: int
    description: Adjusts the sensitivity setting on trackpoint devices. The range is 0 - 255 and the default is 128. You can also adjust this setting at runtime without recompiling using the &mms behavior. If this setting is enabled, then the runtime behavior won't be saved into the runtime settings.

  tp-neg-inertia:
    type: int
    description: Adjusts the negative inertia setting on trackpoint devices. The range is 0 - 255 and the default is 6. You can also adjust this setting at runtime without recompiling using the &mms behavior. If this setting is enabled, then the runtime behavior won't be saved into the runtime settings.

  tp-val6-upper-speed:
    type: int
    description: Adjusts the negative value0 upper plateau speed setting on trackpoint devices. The range is 0 - 255 and the default is 97. You can also adjust this setting at runtime without recompiling using the &mms behavior. If this setting is enabled, then the runtime behavior won't be saved into the runtime settings.

  tp-x-invert:
    type: boolean
    description: Enables x axis inversion on the trackpoint. Only works with some trackpoint devices, but is properly considered by the trackpoint's acceleration features (which may or may not have an impact). Alternatively consider achieving the same effect using the `zmk,input-configs` feature.

  tp-y-invert:
    type: boolean
    description: Enables y axis inversion on the trackpoint. Only works with some trackpoint devices, but is properly considered by the trackpoint's acceleration features (which may or may not have an impact). Alternatively consider achieving the same effect using the `zmk,input-configs` feature.

  tp-xy-swap:
    type: boolean
    description: Swaps the x and y axis on the trackpoint. Only works with some trackpoint devices, but may properly considered by the trackpoint's acceleration features (which may or may not have an impact). Alternatively consider achieving the same effect using the `zmk,input-configs` feature.

  layer-toggle:
    type: int
    required: false
    description: The layer that should be toggled when the mouse is moved.

  wake-gpios:
    type: phandle-array
    required: false
    description: |
      GPIO connected to the PS/2 data line (same physical pin as the
      UART RX). Used by CONFIG_ZMK_INPUT_MOUSE_PS2_IDLE_PM to
      re-configure the pin as a falling-edge GPIO interrupt while the
      UART is suspended, so that motion from the trackpoint itself can
      wake the driver (in addition to local keypresses). Must be
      ACTIVE_LOW (the PS/2 start bit pulls the line low).
```

## src/drivers/input/Kconfig
```kconfig
# Copyright (c) 2022 The ZMK Contributors
# SPDX-License-Identifier: MIT

DT_COMPAT_ZMK_INPUT_PS2_MOUSE := zmk,input-mouse-ps2

config ZMK_INPUT_MOUSE_PS2
	bool
	default $(dt_compat_enabled,$(DT_COMPAT_ZMK_INPUT_PS2_MOUSE))
    # depends on (!ZMK_SPLIT || ZMK_SPLIT_ROLE_CENTRAL)
	select ZMK_MOUSE
    select PS2

config ZMK_INPUT_MOUSE_PS2_ENABLE_PS2_RESEND_CALLBACK
	bool "Get notifications from the underluing PS2 protocol driver when the received data is invalid and when a resend is requested from the peripheral. This helps the mouse driver to re-align its command buffer and prevent unexpected clicks and jerky movements. With the ps2-uart driver this option is not really necessary, but is very useful for the ps2-gpio driver where mis-transmissions are frequent."
	default n

if ZMK_INPUT_MOUSE_PS2

config ZMK_INPUT_MOUSE_PS2_POWER_ON_RESET_TIME
    int "The POR shall be timed to occur 600 ms ± 20 % from the time power is applied to the TrackPoint controller."
    default 600
    help
      Refer to IBM TrackPoint System Version 4.0 Engineering Specification - Section 2.1

config ZMK_INPUT_MOUSE_PS2_ENABLE_UROB_COMPAT
    bool "Makes the driver compatible with urob's zmk fork. His fork has commits that change the default zmk function definitions. This option adopts the code to make it compatible with his changes. Only enable it if you are using his fork or it will fail to compile."
	default n

config ZMK_INPUT_MOUSE_PS2_ENABLE_ERROR_MITIGATION
    bool "Tries to mitigate transmission errors. Only useful when using a PS2 driver that is prone to miscommunication like the GPIO bitbanging driver."
	default n

config ZMK_INPUT_MOUSE_PS2_REPORT_INTERVAL_MIN
    int "Minimum report rate. Use to avoid bluetooth queue overflow."
    default 0
    help
      Default minimum report interval in milliseconds.
      Slow down input reporting for hid queue over the air.

config ZMK_INPUT_MOUSE_PS2_IDLE_PM
    bool "Enable idle power management for PS/2 mouse"
    select PM_DEVICE
    default n
    help
      After a configurable period of trackpoint inactivity, suspend the
      UART peripheral to save power.  Reporting is left enabled (no F5)
      so the trackpoint can still drive the data line on motion.
      If wake-gpios is set in devicetree, the driver reclaims the UART
      RX pin as a GPIO falling-edge interrupt while suspended, allowing
      trackpoint motion itself to wake the driver.  Also wakes on any
      local keypress via ZMK activity events.

config ZMK_INPUT_MOUSE_PS2_IDLE_PM_TIMEOUT_MS
    int "Milliseconds of TP inactivity before suspending"
    depends on ZMK_INPUT_MOUSE_PS2_IDLE_PM
    default 30000
    help
      How long the trackpoint must be idle (no packets) before the driver
      enters dormant state. Default 30 seconds.

config ZMK_INPUT_MOUSE_PS2_TP_REGISTER_DUMP
    bool "Dump all TrackPoint register pages at boot over USB serial"
    default n
    help
      At startup, after the TrackPoint is detected, read and log the
      full internal register map (Page 0: 0x00-0x7F, Page 1: 0x00-0x3F)
      via LOG_INF. Useful for reverse-engineering power management
      registers on Sprintek controllers. Requires USB logging enabled.

config ZMK_INPUT_MOUSE_PS2_TP_REGISTER_PROBE
    bool "Probe a Page 1 TrackPoint register by writing a test value at boot"
    depends on ZMK_INPUT_MOUSE_PS2_TP_REGISTER_DUMP
    default n
    help
      After dumping registers, write a test value to a Page 1 register
      (volatile RAM only — NOT saved to NV, lost on next reset). Used
      for reverse-engineering Sprintek power management. Reads the
      value before and after to confirm the write took effect, then
      lets the driver continue normally so you can measure the effect
      (idle current, behavior, etc).

config ZMK_INPUT_MOUSE_PS2_TP_PROBE_REG
    hex "Page 1 register address to probe (0x00-0x3F)"
    depends on ZMK_INPUT_MOUSE_PS2_TP_REGISTER_PROBE
    default 0x06
    range 0x00 0x3F

config ZMK_INPUT_MOUSE_PS2_TP_PROBE_VAL
    hex "Value to write to the probed register"
    depends on ZMK_INPUT_MOUSE_PS2_TP_REGISTER_PROBE
    default 0x0A
    range 0x00 0xFF

endif # ZMK_INPUT_MOUSE_PS2
```
